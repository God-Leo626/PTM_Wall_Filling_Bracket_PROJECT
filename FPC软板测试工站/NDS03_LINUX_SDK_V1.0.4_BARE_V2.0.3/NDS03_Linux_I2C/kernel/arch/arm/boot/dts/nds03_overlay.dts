/dts-v1/;
/plugin/;

/ {
    fragment@0 {
        target = <&i2c1>;
        __overlay__ {
            clock-frequency = <400000>;
            status = "okay";
            #address-cells = <0x1>;
            #size-cells = <0x0>;

            tof_nds03: tof_nds03@5c {
                compatible = "nx,tof_nds03";
                reg = <0x5c>;
            };
        };
    };
};
